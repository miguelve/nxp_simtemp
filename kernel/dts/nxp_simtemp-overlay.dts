/dts-v1/;
/plugin/;

/ {
    compatible = "brcm,bcm2835";
    
    fragment@0 {
        target-path = "/";
        __overlay__ {
            nxp_simtemp0: nxp_simtemp@0 {
                compatible = "nxp_simtemp";
                dev-index = <0>;
                sampling-ms = <500>;
                threshold-mC = <45000>;
                status = "okay";
            };
        };
    };
};
